## twister-out.1/qemu_cortex_m0/lib/custom_lib/lib.custom_lib.non_default/Kconfig/Kconfig.shield.defconfig
```kconfig
osource "E:/IOT_EMB_SYS/Firmware_workspace/assignment-10/boards/shields/*/Kconfig.defconfig"
```

## twister-out.1/qemu_cortex_m0/lib/custom_lib/lib.custom_lib/Kconfig/Kconfig.modules
```kconfig
menu "assignment-10 (E:/IOT_EMB_SYS/Firmware_workspace/assignment-10)"
osource "E:/IOT_EMB_SYS/Firmware_workspace/assignment-10/Kconfig"
config ZEPHYR_ASSIGNMENT_10_MODULE
	bool
	default y
endmenu
menu "canopennode (E:/IOT_EMB_SYS/Firmware_workspace/modules/lib/canopennode)"
osource "$(ZEPHYR_CANOPENNODE_KCONFIG)"
config ZEPHYR_CANOPENNODE_MODULE
	bool
	default y
endmenu
menu "chre (E:/IOT_EMB_SYS/Firmware_workspace/modules/lib/chre)"
osource "E:/IOT_EMB_SYS/Firmware_workspace/modules/lib/chre/platform/zephyr/Kconfig"
config ZEPHYR_CHRE_MODULE
	bool
	default y
endmenu
menu "fatfs (E:/IOT_EMB_SYS/Firmware_workspace/modules/fs/fatfs)"
osource "$(ZEPHYR_FATFS_KCONFIG)"
config ZEPHYR_FATFS_MODULE
	bool
	default y
endmenu
menu "hal_espressif (E:/IOT_EMB_SYS/Firmware_workspace/modules/hal/espressif)"
osource "E:/IOT_EMB_SYS/Firmware_workspace/modules/hal/espressif/zephyr/Kconfig"
config ZEPHYR_HAL_ESPRESSIF_MODULE
	bool
	default y
endmenu
menu "hal_ethos_u (E:/IOT_EMB_SYS/Firmware_workspace/modules/hal/ethos_u)"
osource "$(ZEPHYR_HAL_ETHOS_U_KCONFIG)"
config ZEPHYR_HAL_ETHOS_U_MODULE
	bool
	default y
endmenu
menu "hal_gigadevice (E:/IOT_EMB_SYS/Firmware_workspace/modules/hal/gigadevice)"
osource "$(ZEPHYR_HAL_GIGADEVICE_KCONFIG)"
config ZEPHYR_HAL_GIGADEVICE_MODULE
	bool
	default y
endmenu
menu "hal_infineon (E:/IOT_EMB_SYS/Firmware_workspace/modules/hal/infineon)"
osource "$(ZEPHYR_HAL_INFINEON_KCONFIG)"
config ZEPHYR_HAL_INFINEON_MODULE
	bool
	default y
endmenu
menu "hal_nordic (E:/IOT_EMB_SYS/Firmware_workspace/modules/hal/nordic)"
osource "$(ZEPHYR_HAL_NORDIC_KCONFIG)"
config ZEPHYR_HAL_NORDIC_MODULE
	bool
	default y
endmenu
menu "hal_nxp (E:/IOT_EMB_SYS/Firmware_workspace/modules/hal/nxp)"
osource "$(ZEPHYR_HAL_NXP_KCONFIG)"
config ZEPHYR_HAL_NXP_MODULE
	bool
	default y
endmenu
menu "hal_rpi_pico (E:/IOT_EMB_SYS/Firmware_workspace/modules/hal/rpi_pico)"
osource "$(ZEPHYR_HAL_RPI_PICO_KCONFIG)"
config ZEPHYR_HAL_RPI_PICO_MODULE
	bool
	default y
endmenu
menu "silabs (E:/IOT_EMB_SYS/Firmware_workspace/modules/hal/silabs)"
osource "E:/IOT_EMB_SYS/Firmware_workspace/modules/hal/silabs/zephyr/Kconfig"
config ZEPHYR_SILABS_MODULE
	bool
	default y
endmenu
menu "hal_telink (E:/IOT_EMB_SYS/Firmware_workspace/modules/hal/telink)"
osource "E:/IOT_EMB_SYS/Firmware_workspace/modules/hal/telink/Kconfig"
config ZEPHYR_HAL_TELINK_MODULE
	bool
	default y
endmenu
menu "liblc3 (E:/IOT_EMB_SYS/Firmware_workspace/modules/lib/liblc3)"
osource "$(ZEPHYR_LIBLC3_KCONFIG)"
config ZEPHYR_LIBLC3_MODULE
	bool
	default y
endmenu
menu "littlefs (E:/IOT_EMB_SYS/Firmware_workspace/modules/fs/littlefs)"
osource "$(ZEPHYR_LITTLEFS_KCONFIG)"
config ZEPHYR_LITTLEFS_MODULE
	bool
	default y
endmenu
menu "loramac-node (E:/IOT_EMB_SYS/Firmware_workspace/modules/lib/loramac-node)"
osource "$(ZEPHYR_LORAMAC_NODE_KCONFIG)"
config ZEPHYR_LORAMAC_NODE_MODULE
	bool
	default y
endmenu
menu "lvgl (E:/IOT_EMB_SYS/Firmware_workspace/modules/lib/gui/lvgl)"
osource "E:/IOT_EMB_SYS/Firmware_workspace/modules/lib/gui/lvgl/zephyr/Kconfig"
config ZEPHYR_LVGL_MODULE
	bool
	default y
endmenu
menu "lz4 (E:/IOT_EMB_SYS/Firmware_workspace/modules/lib/lz4)"
osource "$(ZEPHYR_LZ4_KCONFIG)"
config ZEPHYR_LZ4_MODULE
	bool
	default y
endmenu
menu "mbedtls (E:/IOT_EMB_SYS/Firmware_workspace/modules/crypto/mbedtls)"
osource "$(ZEPHYR_MBEDTLS_KCONFIG)"
config ZEPHYR_MBEDTLS_MODULE
	bool
	default y
endmenu
menu "nanopb (E:/IOT_EMB_SYS/Firmware_workspace/modules/lib/nanopb)"
osource "$(ZEPHYR_NANOPB_KCONFIG)"
config ZEPHYR_NANOPB_MODULE
	bool
	default y
endmenu
menu "openthread (E:/IOT_EMB_SYS/Firmware_workspace/modules/lib/openthread)"
osource "$(ZEPHYR_OPENTHREAD_KCONFIG)"
config ZEPHYR_OPENTHREAD_MODULE
	bool
	default y
endmenu
menu "picolibc (E:/IOT_EMB_SYS/Firmware_workspace/modules/lib/picolibc)"
osource "E:/IOT_EMB_SYS/Firmware_workspace/modules/lib/picolibc/zephyr/Kconfig"
config ZEPHYR_PICOLIBC_MODULE
	bool
	default y
endmenu
menu "segger (E:/IOT_EMB_SYS/Firmware_workspace/modules/debug/segger)"
osource "$(ZEPHYR_SEGGER_KCONFIG)"
config ZEPHYR_SEGGER_MODULE
	bool
	default y
endmenu
menu "sof (E:/IOT_EMB_SYS/Firmware_workspace/modules/audio/sof)"
osource "E:/IOT_EMB_SYS/Firmware_workspace/modules/audio/sof/zephyr/Kconfig"
config ZEPHYR_SOF_MODULE
	bool
	default y
endmenu
menu "tflite-micro (E:/IOT_EMB_SYS/Firmware_workspace/modules/lib/tflite-micro)"
osource "$(ZEPHYR_TFLITE_MICRO_KCONFIG)"
config ZEPHYR_TFLITE_MICRO_MODULE
	bool
	default y
endmenu
menu "TraceRecorder (E:/IOT_EMB_SYS/Firmware_workspace/modules/debug/TraceRecorder)"
osource "E:/IOT_EMB_SYS/Firmware_workspace/modules/debug/TraceRecorder/kernelports/Zephyr/Kconfig"
config ZEPHYR_TRACERECORDER_MODULE
	bool
	default y
endmenu
menu "trusted-firmware-m (E:/IOT_EMB_SYS/Firmware_workspace/modules/tee/tf-m/trusted-firmware-m)"
osource "$(ZEPHYR_TRUSTED_FIRMWARE_M_KCONFIG)"
config ZEPHYR_TRUSTED_FIRMWARE_M_MODULE
	bool
	default y
endmenu
menu "trusted-firmware-a (E:/IOT_EMB_SYS/Firmware_workspace/modules/tee/tf-a/trusted-firmware-a)"
osource "$(ZEPHYR_TRUSTED_FIRMWARE_A_KCONFIG)"
config ZEPHYR_TRUSTED_FIRMWARE_A_MODULE
	bool
	default y
endmenu
menu "uoscore-uedhoc (E:/IOT_EMB_SYS/Firmware_workspace/modules/lib/uoscore-uedhoc)"
osource "$(ZEPHYR_UOSCORE_UEDHOC_KCONFIG)"
config ZEPHYR_UOSCORE_UEDHOC_MODULE
	bool
	default y
endmenu
menu "zcbor (E:/IOT_EMB_SYS/Firmware_workspace/modules/lib/zcbor)"
osource "$(ZEPHYR_ZCBOR_KCONFIG)"
config ZEPHYR_ZCBOR_MODULE
	bool
	default y
endmenu
menu "zscilib (E:/IOT_EMB_SYS/Firmware_workspace/modules/lib/zscilib)"
osource "E:/IOT_EMB_SYS/Firmware_workspace/modules/lib/zscilib/Kconfig.zscilib"
config ZEPHYR_ZSCILIB_MODULE
	bool
	default y
endmenu
menu "thrift (E:/IOT_EMB_SYS/Firmware_workspace/modules/lib/thrift)"
osource "$(ZEPHYR_THRIFT_KCONFIG)"
config ZEPHYR_THRIFT_MODULE
	bool
	default y
endmenu
```
